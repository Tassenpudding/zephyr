## drivers/adc/Kconfig.mcux_lpc_adc
```kconfig
# Copyright 2026 NXP
# SPDX-License-Identifier: Apache-2.0

config ADC_MCUX_LPC_ADC
	bool "NXP LPC 12-bit SAR ADC driver"
	default y
	depends on DT_HAS_NXP_LPC_ADC_ENABLED
	help
	  Enable the driver for the NXP LPC 12-bit SAR ADC (the "GPADC" on the
	  LPC54xxx family, e.g. the LPC546xx). The driver wraps the MCUXpresso
	  SDK lpc_adc component and drives conversion sequence A: the Zephyr ADC
	  channel bitmask is programmed as one hardware sequence and converted
	  on a software trigger.

if ADC_MCUX_LPC_ADC

config ADC_MCUX_LPC_ADC_STREAM
	bool "NXP LPC ADC sequence-B DMA streaming (RTIO)"
	depends on ADC_STREAM
	select DMA
	select DMA_MCUX_LPC
	select NXP_INPUTMUX
	help
	  Enable the high-rate streaming path on conversion sequence B: a CTIMER
	  match triggers the sequence continuously and DMA moves each result into
	  a buffer, exposed through the Zephyr RTIO ADC streaming API
	  (adc_stream()). Used for the HF voltage/current channels. The on-demand
	  sequence-A adc_read() path is unaffected.

config ADC_MCUX_LPC_ADC_STREAM_BLOCK_SAMPLES
	int "Samples per DMA block (per ping-pong buffer)"
	depends on ADC_MCUX_LPC_ADC_STREAM
	default 128
	help
	  Total number of 16-bit ADC samples (summed across all streamed
	  channels) the DMA collects into one ping-pong buffer before raising a
	  completion callback. The per-channel sample count of a streamed frame
	  is this value divided by the number of streamed channels. Larger values
	  reduce interrupt/CQE overhead at the cost of latency and RAM (two such
	  buffers are allocated).

endif # ADC_MCUX_LPC_ADC
```

## drivers/counter/Kconfig.mcux_lpc_rit
```kconfig
# Copyright 2026 NXP
# SPDX-License-Identifier: Apache-2.0

config COUNTER_MCUX_LPC_RIT
	bool "NXP LPC Repetitive Interrupt Timer driver"
	default y
	depends on DT_HAS_NXP_LPC_RIT_ENABLED
	help
	  Enable the Repetitive Interrupt Timer found on NXP LPC parts such as
	  the LPC546xx. The single compare register backs the counter top value,
	  so the device has no alarm channels.
```

## drivers/crypto/Kconfig.mcux_lpc_sha
```kconfig
# Copyright 2026 NXP
# SPDX-License-Identifier: Apache-2.0

config CRYPTO_MCUX_LPC_SHA
	bool "NXP LPC SHA driver"
	default y
	depends on DT_HAS_NXP_LPC_SHA_ENABLED
	help
	  Enable the SHA engine found on NXP LPC parts such as the LPC546xx.
	  The driver exposes SHA-256 through the crypto hash API.
```

## drivers/display/Kconfig.mcux_lcdc
```kconfig
# Copyright 2026 NXP
# SPDX-License-Identifier: Apache-2.0

config DISPLAY_MCUX_LCDC
	bool "MCUX LPC LCDC driver"
	default y
	depends on DT_HAS_NXP_LPC_LCDC_ENABLED
	select PINCTRL
	help
	  Enable support for the NXP LPC LCD controller (LCDC). The driver scans
	  out a full-screen framebuffer supplied by the caller (zero copy), so it
	  is intended to be used with LVGL configured for full-refresh double
	  buffering, with the rendering buffers placed in external SDRAM.
```

## drivers/eeprom/Kconfig.mcux_lpc
```kconfig
# Copyright 2026 NXP
# SPDX-License-Identifier: Apache-2.0

config EEPROM_MCUX_LPC
	bool "NXP LPC on-chip EEPROM driver"
	default y
	depends on DT_HAS_NXP_LPC_EEPROM_ENABLED
	help
	  Enable the driver for the on-chip EEPROM found on NXP LPC parts with a
	  dedicated EEPROM controller, such as the LPC546xx.
```

## drivers/flash/Kconfig.mcux_spifi
```kconfig
# Copyright 2026 NXP
# SPDX-License-Identifier: Apache-2.0

config FLASH_MCUX_SPIFI
	bool "NXP LPC SPIFI serial NOR flash driver"
	default y
	depends on DT_HAS_NXP_LPC_SPIFI_NOR_ENABLED
	select FLASH_HAS_DRIVER_ENABLED
	select FLASH_HAS_EXPLICIT_ERASE
	select FLASH_HAS_PAGE_LAYOUT
	select PINCTRL
	help
	  Enable the driver for a serial NOR flash attached to the NXP LPC
	  SPIFI controller (e.g. on the LPC546xx). The driver wraps the NXP
	  MCUXpresso SDK SPIFI NOR-flash component: it brings up the SPIFI
	  clock/reset/pins and maps Zephyr's flash API onto the vendor
	  Nor_Flash_* calls, discovering the flash geometry from SFDP at boot.
```

## dts/bindings/adc/nxp,lpc-adc.yaml
```yaml
# Copyright 2026 NXP
# SPDX-License-Identifier: Apache-2.0

description: |
  NXP LPC 12-bit SAR ADC (the "GPADC" on the LPC54xxx family).

  This is the sequence-based general-purpose ADC: selected channels are
  programmed as a single conversion sequence (sequence A) and converted
  lowest-channel-first on a software trigger, matching the Zephyr ADC
  channels bitmask directly. The driver wraps the MCUXpresso SDK lpc_adc
  component.

compatible: "nxp,lpc-adc"

include: [adc-controller.yaml, pinctrl-device.yaml]

properties:
  reg:
    required: true

  interrupts:
    required: true

  vref-mv:
    type: int
    default: 3300
    description: |
      ADC reference voltage (VREFP) in millivolts, reported through the
      Zephyr ADC ref_internal API. Defaults to the common 3.3 V rail.

  sample-time:
    type: int
    default: 0
    enum: [0, 1, 2, 3, 4, 5, 6, 7]
    description: |
      Additional sample-time ADC clocks (CTRL.TSAMP field, range 0-7) added
      to the base 2.5 ADC clocks. Increase for higher source impedance.

  dmas:
    description: |
      Optional DMA channel used by the conversion-sequence-B streaming path
      (CONFIG_ADC_MCUX_LPC_ADC_STREAM). Format is <&dma-controller channel>.
      The ADC0-SeqB request is routed to this channel's trigger input via
      INPUTMUX in the driver.

  dma-names:
    enum: ["seqb"]
    description: |
      Name for the streaming DMA channel; must be "seqb".

  nxp,stream-sample-rate-hz:
    type: int
    default: 1000000
    description: |
      Sample rate (per channel) of the CTIMER-triggered sequence-B streaming
      path, in Hz. Defaults to 1 MHz (the legacy firmware's HF acquisition
      rate). Only used when CONFIG_ADC_MCUX_LPC_ADC_STREAM is enabled.

  "#io-channel-cells":
    const: 1

io-channel-cells:
  - input
```

## dts/bindings/adc/ti,ads131m04.yaml
```yaml
# Copyright (c) 2026 Herrmann Ultraschalltechnik GmbH & Co. KG
# SPDX-License-Identifier: Apache-2.0

description: Texas Instruments 4 channels SPI ADC

compatible: "ti,ads131m04"

include: [adc-controller.yaml, spi-device.yaml]

properties:
  "#io-channel-cells":
    const: 1

  drdy-gpios:
    type: phandle-array
    required: true
    description: |
      GPIO for data ready, becomes active when a conversion result is ready.
      By default, it is active low signal.

io-channel-cells:
  - input
```

## dts/bindings/counter/nxp,lpc-rit.yaml
```yaml
# Copyright 2026 NXP
# SPDX-License-Identifier: Apache-2.0

description: |
  NXP LPC Repetitive Interrupt Timer.

  The timer has a single 48 bit compare register, which the driver uses as the
  counter top value, so the device exposes no alarm channels.

compatible: "nxp,lpc-rit"

include: base.yaml

properties:
  reg:
    required: true

  interrupts:
    required: true

  clocks:
    required: true
```

## dts/bindings/crypto/nxp,lpc-sha.yaml
```yaml
# Copyright 2026 NXP
# SPDX-License-Identifier: Apache-2.0

description: |
  NXP LPC SHA engine.

  The block computes SHA-1 and SHA-256. Only SHA-256 is reachable through the
  Zephyr crypto API, which has no SHA-1 algorithm.

compatible: "nxp,lpc-sha"

include: base.yaml

properties:
  reg:
    required: true
```

## dts/bindings/display/nxp,lpc-lcdc.yaml
```yaml
# Copyright 2026 NXP
# SPDX-License-Identifier: Apache-2.0

description: |
  NXP LPC LCD controller (LCDC).

  The LCDC is a parallel-RGB TFT/STN controller. Panel timings are described by
  a "zephyr,panel-timing" child node, matching the convention used by the other
  NXP LCD controller bindings, so panel shields apply unchanged.

compatible: "nxp,lpc-lcdc"

include: [lcd-controller.yaml, pinctrl-device.yaml]

properties:
  reg:
    required: true

  interrupts:
    required: true

  clocks:
    required: true

  data-bus-width:
    type: string
    default: "16-bit"
    enum:
      - "16-bit"
      - "8-bit"
      - "18-bit"
      - "24-bit"
    description:
      LCD data bus width. The default is set to the reset value of 16-bit.

  backlight-gpios:
    type: phandle-array
    description:
      LCD backlight control GPIO. The driver initializes this GPIO to active
      high and toggles it on display blanking on/off.

  pwms:
    type: phandle-array
    description: |
      Optional PWM driving the LCD backlight. When present it takes precedence
      over the backlight-gpios property. The driver implements
      display_set_brightness() (linear 0-255 to duty cycle) and dims via
      full/zero duty on blanking off/on. The PWM period sets the backlight
      frequency.

  memory-region:
    type: phandle
    description:
      Phandle to a reserved memory region (typically external SDRAM) used to
      hold the driver-allocated framebuffers. Required when the controller
      allocates its own framebuffers (CONFIG_MCUX_LCDC_FB_NUM > 0), since a
      full-screen framebuffer does not fit in internal SRAM.

  nxp,swap-red-blue:
    type: boolean
    description:
      Swap the red and blue color components (BGR order). Required on panels
      whose red/blue data lines are wired opposite to the controller's default.
```

## dts/bindings/ethernet/nxp,lpc546xx-ethernet.yaml
```yaml
# Copyright 2026 NXP
# SPDX-License-Identifier: Apache-2.0

description: |
  NXP LPC546xx Ethernet MAC. This is a Synopsys DesignWare EMAC-QoS instance
  driven by the generic dwc_ether_qos core via an LPC546xx platform glue
  (clock gate, block reset, RMII interface select and pin routing).

compatible: "nxp,lpc546xx-ethernet"

include: [ethernet-controller.yaml, pinctrl-device.yaml]

properties:
  reg:
    required: true

  interrupts:
    required: true

  clocks:
    required: true

  pinctrl-0:
    required: true

  pinctrl-names:
    required: true

  phy-connection-type:
    required: true
```

## dts/bindings/memory-controllers/nxp,lpc-emc-sdram.yaml
```yaml
# Copyright 2026 NXP
# SPDX-License-Identifier: Apache-2.0

description: |
  SDRAM chip attached to an NXP LPC EMC dynamic chip-select.

  All timing properties are given in nanoseconds (or, where noted, in EMC clock
  cycles) and are taken from the SDRAM datasheet. They map directly onto the
  fields of the HAL emc_dynamic_timing_config_t / emc_dynamic_chip_config_t
  structures, so the driver stays generic across boards and SDRAM parts.

compatible: "nxp,lpc-emc-sdram"

properties:
  reg:
    type: int
    required: true
    description: EMC dynamic chip-select index this SDRAM is wired to (0 = DYCS0).

  nxp,address-mapping:
    type: int
    required: true
    description: |
      Dynamic device address mapping (the DYNAMICCONFIG AM field). Selects the
      bus width / bank / row / column organisation of the device per the EMC
      address-mapping table in the reference manual.

  nxp,sdram-mode-register:
    type: int
    required: true
    description: |
      Value written to the SDRAM mode register during initialisation. Encodes
      the CAS latency and burst configuration; the driver derives the CAS
      latency from it.

  nxp,ras-latency:
    type: int
    required: true
    description: Active-to-read/write delay (tRCD), in EMC clock cycles.

  nxp,mode-register-delay:
    type: int
    required: true
    description: Load-mode-register to active-command time (tMRD), in EMC clock cycles.

  refresh-period-ns:
    type: int
    required: true
    description: Auto-refresh interval per row, in nanoseconds.

  t-rp-ns:
    type: int
    required: true
    description: Precharge command period (tRP), in nanoseconds.

  t-ras-ns:
    type: int
    required: true
    description: Active-to-precharge command period (tRAS), in nanoseconds.

  t-srex-ns:
    type: int
    required: true
    description: Self-refresh exit time (tSREX), in nanoseconds.

  t-apr-ns:
    type: int
    required: true
    description: Last-data-out to active command time (tAPR), in nanoseconds.

  t-wr-ns:
    type: int
    required: true
    description: |
      Write recovery time contribution (tWR), in nanoseconds. The driver adds
      one EMC clock period to this value, matching the reference design.

  t-rc-ns:
    type: int
    required: true
    description: Active-to-active command period (tRC), in nanoseconds.

  t-rfc-ns:
    type: int
    required: true
    description: Auto-refresh period / refresh-to-active command period (tRFC), in nanoseconds.

  t-xsr-ns:
    type: int
    required: true
    description: Exit self-refresh to active command time (tXSR), in nanoseconds.

  t-rrd-ns:
    type: int
    required: true
    description: Active bank A to active bank B latency (tRRD), in nanoseconds.
```

## dts/bindings/memory-controllers/nxp,lpc-emc.yaml
```yaml
# Copyright 2026 NXP
# SPDX-License-Identifier: Apache-2.0

description: |
  NXP LPC External Memory Controller (EMC).

  The EMC drives external static and dynamic (SDRAM) memories. Each attached
  dynamic memory chip is described by a "nxp,lpc-emc-sdram" child node whose
  unit address is the EMC dynamic chip-select index (0 -> DYCS0 at 0xA0000000,
  1 -> DYCS1, ...). The SDRAM address window itself is declared separately as a
  "zephyr,memory-region" node so the linker can place data in it.

compatible: "nxp,lpc-emc"

include: [base.yaml, pinctrl-device.yaml]

properties:
  reg:
    required: true

  clocks:
    required: true

  "#address-cells":
    required: true
    const: 1

  "#size-cells":
    required: true
    const: 0

  nxp,emc-clock-div:
    type: int
    default: 1
    description: |
      EMC clock divider. The EMC input clock is AHB_CLK / (nxp,emc-clock-div + 1).
      The reset default of 1 (divide by two) is used by the reference design so
      the EMC runs at half the core clock, which keeps the feedback clock stable
      without programming the delay line.

  nxp,emc-big-endian:
    type: boolean
    description: |
      Configure the EMC data bus in big-endian mode. Omit for the default
      little-endian mode.

  nxp,emc-external-feedback-clock:
    type: boolean
    description: |
      Use the external EMC_FBCLK input as the read feedback clock instead of the
      internal loopback of the EMC_CLK output. Omit for internal loopback, which
      is correct for the common case where EMC_FBCLK is not routed on the board.

  nxp,emc-feedback-clock-delay:
    type: int
    default: 0
    description: |
      Feedback-clock delay (SYSCON EMCDLYCTRL FBCLK_DELAY field, 0-31) used to
      align read-data capture with the SDRAM round-trip delay at the configured
      EMC clock. The reset default is generally too small once the EMC runs
      above ~50 MHz, causing corrupted multi-beat (32-bit) reads; the correct
      value is board/frequency specific and best found with a memory test.
      A value of 0 leaves the register at its reset default.
```

## dts/bindings/mtd/nxp,lpc-eeprom.yaml
```yaml
# Copyright 2026 NXP
# SPDX-License-Identifier: Apache-2.0

description: |
  NXP LPC on-chip EEPROM.

  The controller registers and the storage array live in separate regions, so
  the node needs both:

      eeprom0: eeprom@40014000 {
              compatible = "nxp,lpc-eeprom";
              reg = <0x40014000 0x1000>, <0x40108000 DT_SIZE_K(16)>;
              reg-names = "control", "memory";
              interrupts = <52 0>;
              clocks = <&syscon MCUX_BUS_CLK>;
              size = <DT_SIZE_K(16)>;
      };

compatible: "nxp,lpc-eeprom"

include: eeprom-base.yaml

properties:
  reg:
    required: true

  reg-names:
    required: true

  clocks:
    required: true

  size:
    required: true
```
