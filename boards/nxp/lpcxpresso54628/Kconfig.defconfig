## dts/bindings/mtd/nxp,lpc-spifi-nor.yaml
```yaml
# Copyright 2026 NXP
# SPDX-License-Identifier: Apache-2.0

description: |
  NXP LPC SPIFI-attached serial NOR flash.

  The SPIFI block on the LPC54xxx/LPC55xxx families is a dedicated serial
  flash interface with a memory-mapped read window. This node represents the
  SPIFI controller together with the single NOR flash device wired to it; the
  driver auto-detects the flash geometry from SFDP at initialization.

  reg lists two regions selected by reg-names:
    - "control": the SPIFI peripheral register block
    - "memory":  the memory-mapped read window (used for the read path)

  Example:

      &spifi {
          status = "okay";
          pinctrl-0 = <&pinmux_spifi>;
          pinctrl-names = "default";
          spi-max-frequency = <30000000>;
      };

compatible: "nxp,lpc-spifi-nor"

include: [base.yaml, pinctrl-device.yaml, "jedec,jesd216.yaml"]

properties:
  reg:
    required: true

  reg-names:
    required: true

  pinctrl-0:
    required: true

  pinctrl-names:
    required: true

  spi-max-frequency:
    type: int
    default: 30000000
    description: |
      Maximum SCK frequency in Hz for the memory read command issued after
      SFDP discovery. The default (30 MHz) is safe for the basic (0x03) read
      command this driver uses; the SFDP probe itself always runs slower.
```

## dts/bindings/rng/nxp,lpc546xx-rng.yaml
```yaml
# Copyright 2026 NXP
# SPDX-License-Identifier: Apache-2.0

description: |
  LPC546xx Random Number Generator.

  The generator has no memory mapped register interface. Random words are read
  through the rngRead() entry of the OTP driver in boot ROM, so the node carries
  no reg property.

compatible: "nxp,lpc546xx-rng"

include: base.yaml
```
