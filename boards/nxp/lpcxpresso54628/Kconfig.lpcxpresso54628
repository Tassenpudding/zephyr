## boards/nxp/lpcxpresso54628/Kconfig.lpcxpresso54628
```kconfig
# LPCXpresso54628 board

# Copyright 2017, 2024 NXP
# SPDX-License-Identifier: Apache-2.0

config BOARD_LPCXPRESSO54628
	select SOC_LPC54628
	select SOC_PART_NUMBER_LPC54628J512ET180
```

## boards/nxp/lpcxpresso54628/board.yml
```yaml
board:
  name: lpcxpresso54628
  full_name: LPCXPRESSO54628
  vendor: nxp
  socs:
    - name: lpc54628
```
